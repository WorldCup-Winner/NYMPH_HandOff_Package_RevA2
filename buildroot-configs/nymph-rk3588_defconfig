## buildroot-configs/nymph-rk3588_defconfig
```kconfig
BR2_aarch64=y
BR2_ARCH="aarch64"
BR2_ARCH_IS_64=y
BR2_ENDIAN="LITTLE"
BR2_GCC_TARGET_ARCH="armv8-a"
BR2_GCC_TARGET_CPU="cortex-a76"
BR2_GCC_TARGET_ABI="lp64"
BR2_GCC_TARGET_FPU=""
BR2_GCC_TARGET_FLOAT_ABI=""
BR2_GCC_TARGET_MODE=""

# Toolchain
BR2_TOOLCHAIN_BUILDROOT_CXX=y
BR2_TOOLCHAIN_BUILDROOT_WCHAR=y
BR2_TOOLCHAIN_BUILDROOT_CXX=y

# System
BR2_TARGET_GENERIC_HOSTNAME="nymph"
BR2_TARGET_GENERIC_ISSUE="Welcome to NYMPH 1.1"
BR2_ROOTFS_DEVICE_CREATION_DYNAMIC_EUDEV=y
BR2_TARGET_GENERIC_GETTY_PORT="ttyS2"
BR2_TARGET_GENERIC_GETTY_BAUDRATE_115200=y
BR2_SYSTEM_DHCP="eth0"

# Init system
BR2_INIT_SYSTEMD=y
BR2_PACKAGE_SYSTEMD=y

# Packages
BR2_PACKAGE_BUSYBOX=y
BR2_PACKAGE_PYTHON3=y
BR2_PACKAGE_PYTHON3_PY_PYC=y
BR2_PACKAGE_OPENSSL=y
BR2_PACKAGE_LIBCURL=y
BR2_PACKAGE_CA_CERTIFICATES=y

# Network tools
BR2_PACKAGE_IPROUTE2=y
BR2_PACKAGE_IPUTILS=y

# Development tools (for debugging)
BR2_PACKAGE_STRACE=y
BR2_PACKAGE_GDB=y
BR2_PACKAGE_GDB_DEBUGGER=y

# Filesystem
BR2_ROOTFS_OVERLAY="../NYMPH_HandOff_Package_RevA2/buildroot-configs/rootfs-overlay"

# Kernel (external - to be configured when BSP available)
# BR2_LINUX_KERNEL=y
# BR2_LINUX_KERNEL_CUSTOM_TARBALL=y
# BR2_LINUX_KERNEL_CUSTOM_TARBALL_LOCATION="$(TOPDIR)/../linux-rk3588.tar.gz"
# BR2_LINUX_KERNEL_DEFCONFIG="rk3588_nymph"
```
